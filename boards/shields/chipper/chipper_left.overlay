// This file was generated from a template. Edit it to match your keyboard.
// See https://zmk.dev/docs/development/hardware-integration/new-shield for more
// instructions.

#include "chipper.dtsi"

&kscan0 {
    col-gpios
        = <&gpio0 10 GPIO_ACTIVE_HIGH>   // Col0 (Far Outer Edge / Pinky - NFC Pin)
        , <&gpio1 15 GPIO_ACTIVE_HIGH>   // Col1
        , <&gpio1 14 GPIO_ACTIVE_HIGH>   // Col2
        , <&gpio1 13 GPIO_ACTIVE_HIGH>   // Col3
        , <&gpio1 12 GPIO_ACTIVE_HIGH>   // Col4
        , <&gpio1 11 GPIO_ACTIVE_HIGH>   // Col5 (Inner Edge / Index-Thumb)
        ;
};